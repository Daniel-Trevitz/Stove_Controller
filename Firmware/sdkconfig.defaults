## Firmware/sdkconfig.defaults
```kconfig
CONFIG_IDF_TARGET="esp32s2"
CONFIG_IDF_TARGET_ESP32S2=y
CONFIG_ESP_CONSOLE_USB_CDC=y
CONFIG_ESPTOOLPY_PORT="/dev/ttyACM0"
CONFIG_ESPTOOLPY_FLASHSIZE_4MB=y
CONFIG_PARTITION_TABLE_TWO_OTA=y
CONFIG_HTTPD_MAX_REQ_HDR_LEN=4096
CONFIG_HTTPD_MAX_URI_LEN=4096
```
